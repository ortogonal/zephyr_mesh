## boards/xtensa/esp32_wroom_devkitc/Kconfig.board
```kconfig
# ESP32 board configuration

# Copyright (c) 2017 Intel Corporation
# SPDX-License-Identifier: Apache-2.0

config BOARD_ESP32_WROOM_DEVKITC
	bool "ESP32 Development Board (WROOM devkitc)"
	depends on SOC_ESP32
```
